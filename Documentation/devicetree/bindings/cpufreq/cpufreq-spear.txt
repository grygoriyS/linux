## Documentation/devicetree/bindings/cpufreq/cpufreq-spear.txt
```
SPEAr cpufreq driver
-------------------

SPEAr SoC cpufreq driver for CPU frequency scaling.
It supports both uniprocessor (UP) and symmetric multiprocessor (SMP) systems
which share clock across all CPUs.

Required properties:
- compatible: "st,cpufreq-spear"
- cpufreq_tbl: Table of frequencies CPU could be transitioned into, in the
  increasing order.

Optional properties:
- clock-latency: Specify the possible maximum transition latency for clock, in
  unit of nanoseconds.

Examples:
--------

cpufreq {
	compatible = "st,cpufreq-spear";
	cpufreq_tbl = < 166000
			200000
			250000
			300000
			400000
			500000
			600000 >;
};
```

## Documentation/devicetree/bindings/dma/omap-sdma.txt
```
* TI OMAP SDMA controller

Required properties:
- compatible: 		Must be "ti,omap-sdma"
- reg: 			Contains DMA registers location and length.
- interrupts: 		Contains DMA interrupt information.
- #dma-cells: 		Must be 1.
- #dma-channels:	Contains total number of programmable DMA channels.
- #dma-requests:	Contains total number of DMA requests.

Example:

	sdma: dma-controller@4A056000 {
		compatible = "ti,omap-sdma";
		reg = <0x4A056000 0x1000>;
		interrupts = <0 12 0x4>,
			     <0 13 0x4>,
			     <0 14 0x4>,
			     <0 15 0x4>;
		#dma-cells = <1>;
		#dma-channels = <32>;
		#dma-requests = <127>;
	};


* TI OMAP SDMA clients

Required properties:
- dmas:			List of one or more DMA specifiers, each consisting of
			- A phandle pointing to DMA controller node
			- The DMA request number associated with client device
- dma-names: 		Contains one identifier string for each dma specifier in
			the dmas property. The specific strings that can be used
			are defined in the binding of the DMA client device.

Example:

	mmc1: mmc@4809c000 {
		...
		dmas = <&sdma 61>,	/* TX channel */
		       <&sdma 62>;	/* RX channel */
		dma-names = "tx", "rx";
		...
	};
```

## Documentation/devicetree/bindings/gpio/gpio-davinci.txt
```
Davinci/Keystone General-Purpose Input/Output (GPIO) peripheral bindings

Davinci GPIO IP is composite device which has common Configuration
registers and set GPIO bank blocks with up to 32 GPIO lines per each.
Each GPIO line can be configured to generate irq. Two IRQ generation modes
can be supported (depend on SoC): banked irqs, unbanked irqs.
	banked irqs: one IRQ is assigned for 16 GPIO lines (up to 2 IRQ per bank)
	unbanked irqs: one IRQ is directly mapped to one GPIO line
				 (up to 32 IRQs only for bank 0)

The Davinci GPIO IP represented in DT as subtree of devices where root
node is GPIO controller and sub-nodes are GPIO banks.

For references see User guide section on:
http://www.ti.com/product/tms320dm365
http://www.ti.com/product/tms320dm355
http://www.ti.com/product/omap-l138


Davinci GPIO controller

Required Properties:
- compatible: should be "ti,davinci-gpio","ti,keystone-gpio"
- reg:	Physical base address of the common Configuration registers and the
		size of mapped memory.
- #address-cells = <1>;
- #size-cells = <1>;
- ranges;

Optional properties:
- clocks:	phandle reference to the controller clock. Required only
			if clock tree data present in device tree.
			See clock-bindings.txt
- clock-names:	clock name. It has to be "aemif". Required only if clock
				tree data present in device tree, in another case don't
				use it.
				See clock-bindings.txt


Davinci GPIO bank

Required Properties:
- compatible: should be "ti,davinci-gpio-bank","ti,keystone-gpio-bank"
- reg:	Physical base address of GPIO bank registers and the
		size of mapped memory.
- gpio-controller:	Marks the device node as a gpio controller.
					see Documentation/devicetree/bindings/gpio/gpio.txt
- interrupt-parent:	phandle of the parent interrupt controller.
- interrupts:	Array of GPIO interrupt number. Only banked or unbanked IRQs are
				supported at a time.
- ti,ngpio: The number of GPIO pins supported.

Optional properties:
- ti,davinci-gpio-unbanked:	The number of GPIOs that have an individual interrupt
		 					line to processor. Unbanked GPIOs are unsupported if
		 					not present.

The GPIO bank also may acts as an interrupt controller if it's configured
to use banked irqs . It uses the default two cells specifier as described in
Documentation/devicetree/bindings/interrupt-controller/interrupts.txt.

Example for http://www.ti.com/product/omap-l138:

gpio-controller@1e26000 {
	compatible = "ti,davinci-gpio";
	gpio-controller;
	reg = <0x226000 0x10>;
	ranges;

		gpio0: gpio-bank@1e26010 {
			compatible = "ti,davinci-gpio-bank";
			reg = <0x226010 0x28>;
			interrupt-parent = <&intc>;
			interrupts = <42 IRQ_TYPE_EDGE_BOTH 43 IRQ_TYPE_EDGE_BOTH>;
			ti,ngpio = <32>;
			interrupt-controller;
			#interrupt-cells = <2>;
		}

		gpio1: gpio-bank@1e26038 {
			compatible = "ti,davinci-gpio-bank";
			reg = <0x226038 0x28>;
			interrupt-parent = <&intc>;
			interrupts = <44 IRQ_TYPE_EDGE_BOTH 45 IRQ_TYPE_EDGE_BOTH>;
			ti,ngpio = <32>;
			interrupt-controller;
			#interrupt-cells = <2>;
		}

		gpio2: gpio-bank@1e26060 {
			compatible = "ti,davinci-gpio-bank";
			reg = <0x226060 0x28>;
			interrupt-parent = <&intc>;
			interrupts = <46 IRQ_TYPE_EDGE_BOTH 47 IRQ_TYPE_EDGE_BOTH>;
			ti,ngpio = <32>;
			interrupt-controller;
			#interrupt-cells = <2>;
		}

		gpio3: gpio-bank@1e26088 {
			compatible = "ti,davinci-gpio-bank";
			reg = <0x226088 0x28>;
			interrupt-parent = <&intc>;
			interrupts = <48 IRQ_TYPE_EDGE_BOTH 49 IRQ_TYPE_EDGE_BOTH>;
			ti,ngpio = <32>;
			interrupt-controller;
			#interrupt-cells = <2>;
		}

		gpio4: gpio-bank@1e260b0 {
			compatible = "ti,davinci-gpio-bank";
			reg = <0x2260b0 0x28>;
			interrupt-parent = <&intc>;
			interrupts = <50 IRQ_TYPE_EDGE_BOTH>;
			ti,ngpio = <16>;
			interrupt-controller;
			#interrupt-cells = <2>;
		}
};
```

## Documentation/devicetree/bindings/net/ti,cpsw-switch.txt
```
TI SoC Ethernet Switch Controller Device Tree Bindings (new)
------------------------------------------------------

The 3-port switch gigabit ethernet subsystem provides ethernet packet
communication and can be configured as an ethernet switch. It provides the
gigabit media independent interface (GMII),reduced gigabit media
independent interface (RGMII), reduced media independent interface (RMII),
the management data input output (MDIO) for physical layer device (PHY)
management.

Required properties:
- compatible : be one of the below:
	  "ti,cpsw-switch" for backward compatible
	  "ti,am335x-cpsw-switch" for AM335x controllers
	  "ti,am4372-cpsw-switch" for AM437x controllers
	  "ti,dra7-cpsw-switch" for DRA7x controllers
- reg : physical base address and size of the CPSW module IO range
- ranges : shall contain the CPSW module IO range available for child devices
- clocks : should contain the CPSW functional clock
- clock-names : should be "fck"
	See bindings/clock/clock-bindings.txt
- interrupts : should contain CPSW RX_THRESH, RX, TX, MISC interrupts
- interrupt-names : should contain "rx_thresh", "rx", "tx", "misc"
	See bindings/interrupt-controller/interrupts.txt

Optional properties:
- syscon : phandle to the system control device node which provides access to
	efuse IO range with MAC addresses

Required Sub-nodes:
- ethernet-ports : contains CPSW external ports descriptions
	Required properties:
	- #address-cells : Must be 1
	- #size-cells : Must be 0
	- reg : CPSW port number. Should be 1 or 2
	- phys : phandle on phy-gmii-sel PHY (see phy/ti-phy-gmii-sel.txt)
	- phy-mode : See [1]
	- phy-handle : See [1]

	Optional properties:
	- label : Describes the label associated with this port
	- ti,dual-emac-pvid : Specifies default PORT VID to be used to segregate
		ports. Default value - CPSW port number.
	- mac-address : See [1]
	- local-mac-address : See [1]

- mdio : CPSW MDIO bus block description
	- bus_freq : MDIO Bus frequency
	See bindings/net/mdio.txt and davinci-mdio.txt

- cpts : The Common Platform Time Sync (CPTS) module description
	- clocks : should contain the CPTS reference clock
	- clock-names : should be "cpts"
	See bindings/clock/clock-bindings.txt

	Optional properties - all ports:
	- cpts_clock_mult : Numerator to convert input clock ticks into ns
	- cpts_clock_shift : Denominator to convert input clock ticks into ns
			  Mult and shift will be calculated basing on CPTS
			  rftclk frequency if both cpts_clock_shift and
			  cpts_clock_mult properties are not provided.

[1] See Documentation/devicetree/bindings/net/ethernet-controller.yaml

Examples:

mac_sw: ethernet_switch@0 {
	compatible = "ti,dra7-cpsw-switch","ti,cpsw-switch";
	reg = <0x0 0x4000>;
	ranges = <0 0 0x4000>;
	clocks = <&gmac_main_clk>;
	clock-names = "fck";
	#address-cells = <1>;
	#size-cells = <1>;
	syscon = <&scm_conf>;
	status = "disabled";

	interrupts = <GIC_SPI 334 IRQ_TYPE_LEVEL_HIGH>,
		     <GIC_SPI 335 IRQ_TYPE_LEVEL_HIGH>,
		     <GIC_SPI 336 IRQ_TYPE_LEVEL_HIGH>,
		     <GIC_SPI 337 IRQ_TYPE_LEVEL_HIGH>;
	interrupt-names = "rx_thresh", "rx", "tx", "misc"

	ports {
		#address-cells = <1>;
		#size-cells = <0>;

		cpsw_port1: port@1 {
			reg = <1>;
			label = "port1";
			/* Filled in by U-Boot */
			mac-address = [ 00 00 00 00 00 00 ];
			phys = <&phy_gmii_sel 1>;
		};

		cpsw_port2: port@2 {
			reg = <2>;
			label = "wan";
			/* Filled in by U-Boot */
			mac-address = [ 00 00 00 00 00 00 ];
			phys = <&phy_gmii_sel 2>;
		};
	};

	davinci_mdio_sw: mdio@1000 {
		compatible = "ti,cpsw-mdio","ti,davinci_mdio";
		#address-cells = <1>;
		#size-cells = <0>;
		ti,hwmods = "davinci_mdio";
		bus_freq = <1000000>;
		reg = <0x1000 0x100>;
	};

	cpts {
		clocks = <&gmac_clkctrl DRA7_GMAC_GMAC_CLKCTRL 25>;
		clock-names = "cpts";
	};
};

&mac_sw {
	pinctrl-names = "default", "sleep";
	status = "okay";
};

&cpsw_port1 {
	phy-handle = <&ethphy0_sw>;
	phy-mode = "rgmii";
	ti,dual_emac_pvid = <1>;
};

&cpsw_port2 {
	phy-handle = <&ethphy1_sw>;
	phy-mode = "rgmii";
	ti,dual_emac_pvid = <2>;
};

&davinci_mdio_sw {
	ethphy0_sw: ethernet-phy@0 {
		reg = <0>;
	};

	ethphy1_sw: ethernet-phy@1 {
		reg = <1>;
	};
};
```
